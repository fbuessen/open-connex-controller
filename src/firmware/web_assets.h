// Generated by scripts/build_firmware_web.cjs. Edit web/ sources.
#pragma once
#include <Arduino.h>
namespace firmware {
const char kIndex[] PROGMEM = R"HTML(<!doctype html>
<html lang="en">
<head>
  <meta charset="utf-8">
  <meta name="viewport" content="width=device-width,initial-scale=1">
<meta name="color-scheme" content="light">
  <meta name="referrer" content="no-referrer">
  <title>Open Connex Controller</title>
  <link rel="icon" href="/favicon.svg" type="image/svg+xml">
  <link rel="stylesheet" href="/style.css">
  <script src="/app.js" defer></script>
</head>
<body>
  <section id="loading-view" class="loading" role="status">Connecting to your controller… <button id="retry-load" class="btn secondary" type="button" hidden>Retry</button></section>
  <svg class="sprite" aria-hidden="true"><defs>
    <symbol id="i-grid" viewBox="0 0 24 24"><rect x="3" y="3" width="7" height="7" rx="2"/><rect x="14" y="3" width="7" height="7" rx="2"/><rect x="3" y="14" width="7" height="7" rx="2"/><rect x="14" y="14" width="7" height="7" rx="2"/></symbol>
    <symbol id="i-sliders" viewBox="0 0 24 24"><path d="M4 7h8m4 0h4M4 17h3m4 0h9"/><circle cx="14" cy="7" r="2"/><circle cx="9" cy="17" r="2"/></symbol>
    <symbol id="i-shield" viewBox="0 0 24 24"><path d="m12 3 8 3v6c0 5-8 9-8 9s-8-4-8-9V6z"/><path d="m8 12 3 3 5-6"/></symbol>
    <symbol id="i-lock" viewBox="0 0 24 24"><rect x="5" y="10" width="14" height="11" rx="2"/><path d="M8 10V7a4 4 0 0 1 8 0v3m-4 4v3"/></symbol>
    <symbol id="i-key" viewBox="0 0 24 24"><circle cx="8" cy="9" r="5"/><path d="m12 13 8 8m-4-4 2-2m-5-1 2-2"/></symbol>
    <symbol id="i-leaf" viewBox="0 0 24 24"><path d="M20 3c-1 8 2 15-9 15-6 0-8-6-4-10 3-3 8-2 13-5ZM4 21 15 10"/></symbol>
    <symbol id="i-sun" viewBox="0 0 24 24"><circle cx="12" cy="12" r="4"/><path d="M12 2v2m0 16v2M2 12h2m16 0h2M5 5l1.4 1.4m11.2 11.2L19 19M5 19l1.4-1.4M17.6 6.4 19 5"/></symbol>
    <symbol id="i-sofa" viewBox="0 0 24 24"><path d="M5 12V8a3 3 0 0 1 3-3h8a3 3 0 0 1 3 3v4M5 14h14M5 19v2m14-2v2"/><path d="M5 11a2 2 0 0 0-4 0v5a3 3 0 0 0 3 3h16a3 3 0 0 0 3-3v-5a2 2 0 0 0-4 0v3H5z"/></symbol>
    <symbol id="i-bed" viewBox="0 0 24 24"><path d="M3 18v3m18-3v3M3 10V5h18v5M1 18v-5a3 3 0 0 1 3-3h16a3 3 0 0 1 3 3v5zM5 10V7h5v3m4 0V7h5v3"/></symbol>
    <symbol id="i-desk" viewBox="0 0 24 24"><rect x="4" y="3" width="16" height="11" rx="2"/><path d="M12 14v4m-4 0h8M2 21h20M4 21v-3m16 3v-3"/></symbol>
    <symbol id="i-kitchen" viewBox="0 0 24 24"><rect x="3" y="3" width="18" height="18" rx="2"/><path d="M3 9h18M7 6h1m4 0h1m4 0h.01"/><rect x="6" y="12" width="12" height="6" rx="1"/></symbol>
    <symbol id="i-bathroom" viewBox="0 0 24 24"><path d="M3 12h18v3a5 5 0 0 1-5 5H8a5 5 0 0 1-5-5zm3 8v2m12-2v2M5 12V5a3 3 0 0 1 6 0v1m-2 1h4m-2 2v.01"/></symbol>
    <symbol id="i-hallway" viewBox="0 0 24 24"><path d="M5 21V3h14v18M2 21h20M8 21V6l8-2v17m-3-8h.01"/></symbol>
    <symbol id="i-plus" viewBox="0 0 24 24"><path d="M12 5v14M5 12h14"/></symbol>
    <symbol id="i-wifi" viewBox="0 0 24 24"><path d="M2 8a16 16 0 0 1 20 0M5 12a11 11 0 0 1 14 0m-11 4a6 6 0 0 1 8 0m-4 4h.01"/></symbol>
    <symbol id="i-info" viewBox="0 0 24 24"><circle cx="12" cy="12" r="9"/><path d="M12 11v6m0-10h.01"/></symbol>
    <symbol id="i-arrow" viewBox="0 0 24 24"><path d="M4 12h16m-6-6 6 6-6 6"/></symbol>
    <symbol id="i-exit" viewBox="0 0 24 24"><path d="M9 4H4v16h5m6-4 4-4-4-4M9 12h10"/></symbol>
    <symbol id="i-close" viewBox="0 0 24 24"><path d="m6 6 12 12M6 18 18 6"/></symbol>
    <symbol id="i-copy" viewBox="0 0 24 24"><rect x="8" y="8" width="12" height="13" rx="2"/><path d="M15 8V3H3v13h5"/></symbol>
    <symbol id="i-check" viewBox="0 0 24 24"><path d="m5 12 4 4L19 6"/></symbol>
    <symbol id="i-radio" viewBox="0 0 24 24"><circle cx="12" cy="12" r="2"/><path d="M7 7a7 7 0 0 0 0 10m10-10a7 7 0 0 1 0 10M3 3a13 13 0 0 0 0 18M21 3a13 13 0 0 1 0 18"/></symbol>
  </defs></svg>
  <div class="shell" id="app-shell" hidden>
    <aside class="sidebar" aria-label="Main navigation">
      <div class="sidebar-main"><div class="brand"><div class="brand-mark" aria-hidden="true"><span></span><span></span><span></span></div><div class="brand-name">Open Connex Controller</div></div>
      <div><p class="eyebrow">Your controller</p><nav class="nav"><button data-page="zones" aria-current="page"><svg aria-hidden="true"><use href="#i-grid"/></svg>Zones</button><button data-page="settings"><svg aria-hidden="true"><use href="#i-sliders"/></svg>Settings</button></nav></div>
      </div><div class="sidebar-bottom"><div class="side-note">Your home. Your controller.<br>No cloud required.</div></div>
    </aside>
    <main class="content">
      <section class="page" id="page-zones" aria-labelledby="zones-heading">
        <div class="page-heading"><div><h1 id="zones-heading">Zones</h1><p>Manage target temperatures and operating modes.</p></div></div>
        <div class="zone-grid" id="zone-grid"></div>

        <footer class="dashboard-bottom"><span>Open Connex Controller</span><button class="btn quiet" id="refresh" type="button">Refresh</button></footer>
      </section>
      <section class="page" id="page-settings" hidden aria-labelledby="settings-heading">
        <div class="page-heading"><div><h1 id="settings-heading">Settings</h1><p>Manage your zones, access and network connections.</p></div></div>
        <div class="tabs" role="tablist" aria-label="Settings sections"><button id="tab-zones" role="tab" aria-controls="settings-zones" aria-selected="true" data-tab="zones">Zones</button><button id="tab-security" role="tab" aria-controls="settings-security" aria-selected="false" tabindex="-1" data-tab="security">Security</button><button id="tab-wifi" role="tab" aria-controls="settings-wifi" aria-selected="false" tabindex="-1" data-tab="wifi">Wi-Fi</button><button id="tab-controller" role="tab" aria-controls="settings-controller" aria-selected="false" tabindex="-1" data-tab="controller">Controller</button></div>
        <div id="settings-zones" role="tabpanel" aria-labelledby="tab-zones"><div class="settings-stack"><article class="panel"><header class="section-heading"><div><h2>Your zones</h2><p>Names, room icons and heater settings.</p></div><button class="btn" id="add-zone"><svg aria-hidden="true"><use href="#i-plus"/></svg>Add zone</button></header><div class="zone-list" id="zone-list"></div><p class="zone-list-footer" id="zone-count"></p></article></div></div>
        <div id="settings-security" role="tabpanel" aria-labelledby="tab-security" hidden>
          <div class="settings-stack">
            <article class="panel"><div class="panel-heading"><div class="panel-icon"><svg aria-hidden="true"><use href="#i-lock"/></svg></div><div><h2>Web interface password</h2><p>Sign in with this password to use the dashboard.</p></div></div><div class="setting-row"><div><h3>Password configured</h3><p>Choose a unique password at first setup.</p></div><button class="btn secondary" id="change-password">Change password</button></div><div class="panel-bottom"><span class="badge green"><svg class="inline-2" aria-hidden="true"><use href="#i-check"/></svg>Password protected</span></div></article>
            <article class="panel"><div class="panel-heading"><div class="panel-icon"><svg aria-hidden="true"><use href="#i-key"/></svg></div><div><h2>API access</h2><p>Connect Home Assistant and other automations using a token.</p></div></div><div class="setting-row"><div><h3 id="token-title">No API token yet</h3><p id="token-description">Generate one when you’re ready to connect.</p></div><span id="token-status" class="badge neutral">Not generated</span></div><div id="token-display" class="token-display" hidden><label class="field" for="token-value">API token</label><textarea id="token-value" class="token-value" rows="3" readonly spellcheck="false"></textarea><button id="copy-token" class="btn secondary inline-3"><svg aria-hidden="true"><use href="#i-copy"/></svg>Copy token</button><p id="copy-status" class="hint inline-4" role="status"></p></div><div class="panel-bottom"><button class="btn" id="generate-token"><svg aria-hidden="true"><use href="#i-plus"/></svg><span id="token-action-label">Generate token</span></button><button class="btn quiet" id="revoke-token" hidden>Revoke token</button></div><p class="hint inline-5">Rotating replaces the current token immediately. Update Home Assistant and scripts with the new token.</p></article>
            <article class="panel session-panel"><div class="setting-row"><div class="session-title"><div class="panel-icon"><svg aria-hidden="true"><use href="#i-exit"/></svg></div><div><h2>Session</h2><p>Signed in on this browser.</p></div></div><button class="btn secondary" id="sign-out"><svg aria-hidden="true"><use href="#i-exit"/></svg>Sign out</button></div></article>
          </div>
        </div>
        <div id="settings-wifi" role="tabpanel" aria-labelledby="tab-wifi" hidden><article class="panel wifi-layout"><div class="panel-heading"><div class="panel-icon"><svg aria-hidden="true"><use href="#i-wifi"/></svg></div><div><h2>Wi-Fi connection</h2><p>Keep your controller on your local Wi-Fi network.</p></div></div><div class="wifi-banner"><div class="row"><svg aria-hidden="true"><use href="#i-wifi"/></svg><strong id="current-wifi">Loading network…</strong></div><span class="badge neutral" id="wifi-connection"></span></div><form id="wifi-form"><div class="row spread inline-6"><span class="small muted" id="scan-status" role="status">Find a network, or enter its name.</span><button type="button" class="btn secondary" id="scan-wifi">Scan networks</button></div><label class="field">Nearby networks<select id="wifi-networks"><option value="">Choose a network</option></select></label><label class="field">Network name<input id="wifi-ssid" name="ssid" required maxlength="32" autocomplete="off"><span class="hint">You can enter a hidden network’s name here.</span></label><label class="field">Wi-Fi password<input name="password" type="password" autocomplete="new-password" placeholder="Enter Wi-Fi password" maxlength="64"><span class="hint">The existing Wi-Fi password is never displayed.</span></label><p class="hint">A successful change disconnects this page. If the new connection fails, the controller returns to its previous network.</p><div class="dialog-actions"><button class="btn" type="submit">Save Wi-Fi connection</button></div></form></article></div>
        <div id="settings-controller" role="tabpanel" aria-labelledby="tab-controller" hidden><article class="panel wifi-layout"><div class="panel-heading"><div class="panel-icon"><svg aria-hidden="true"><use href="#i-sliders"/></svg></div><div><h2>Controller information</h2><p>Device details and API address.</p></div></div><dl class="facts"><div><dt>Controller ID</dt><dd class="mono" id="device-id"></dd></div><div><dt>Firmware</dt><dd id="firmware-version"></dd></div><div><dt>Controller health</dt><dd id="device-health"></dd></div><div><dt>API base URL</dt><dd class="mono" id="api-url"></dd></div></dl></article><p class="hint inline-7">Controller health does not indicate heater availability.</p></div>
      </section>
    </main>
  </div>
  <section class="login" id="login-view" hidden aria-labelledby="login-heading"><div class="login-art"><div class="brand"><div class="brand-mark" aria-hidden="true"><span></span><span></span><span></span></div><div class="brand-name">Open Connex Controller</div></div><div class="login-copy"><h1>Your home.<br>Your controller.</h1><p>No cloud required.</p></div><div class="rings" aria-hidden="true"></div></div><div class="login-form-wrap"><div class="login-form-inner"><div class="login-lock"><svg aria-hidden="true"><use href="#i-lock"/></svg></div><h2 id="login-heading">Sign in</h2><p id="login-description">Sign in to your local controller.</p><form id="login-form"><label class="field">Web interface password<input id="login-password" name="password" type="password" autocomplete="current-password" required placeholder="Enter your password"></label><p class="form-error" id="login-error" role="alert"></p><button class="btn" type="submit">Sign in<svg aria-hidden="true"><use href="#i-arrow"/></svg></button></form></div></div></section>

  <section class="onboarding" id="setup-view" hidden aria-labelledby="setup-heading">
    <aside class="setup-intro">
      <div class="brand"><div class="brand-mark" aria-hidden="true"><span></span><span></span><span></span></div><div class="brand-name">Open Connex Controller</div></div>
      <div><h1 id="setup-heading" tabindex="-1">Set up your controller</h1><p id="setup-intro-copy">Connect to your home Wi-Fi and choose a password for the web interface.</p>
        <ol class="setup-steps"><li><svg aria-hidden="true"><use href="#i-wifi"/></svg>Choose your Wi-Fi network</li><li><svg aria-hidden="true"><use href="#i-lock"/></svg>Create your web password</li><li><svg aria-hidden="true"><use href="#i-check"/></svg>Reconnect on your home network</li></ol>
      </div>
      <div class="setup-tagline">Your home. Your controller.<br>No cloud required.</div>
    </aside>
    <div class="setup-content"><div class="setup-inner">
      <form id="setup-form">
        <article class="panel" id="setup-wifi-panel"><div class="panel-heading"><div class="panel-icon"><svg aria-hidden="true"><use href="#i-wifi"/></svg></div><div><h2>Home Wi-Fi</h2><p>Choose a network, or enter its name manually.</p></div></div>
          <div class="setup-network-row"><span class="hint" id="setup-scan-status" role="status">Scan for nearby networks.</span><button class="btn secondary" id="setup-scan" type="button">Scan networks</button></div>
          <label class="field">Nearby networks<select id="setup-networks"><option value="">Choose a network</option></select></label>
          <label class="field">Network name<input id="setup-ssid" name="ssid" required maxlength="32" autocomplete="off" placeholder="Your network name"><span class="hint">Hidden networks can be entered here.</span></label>
          <label class="field">Wi-Fi password<input name="wifiPassword" type="password" maxlength="64" autocomplete="new-password" placeholder="Enter Wi-Fi password"><span class="hint">Leave blank for an open network.</span></label>
        </article>
        <article class="panel" id="setup-password-panel"><div class="panel-heading"><div class="panel-icon"><svg aria-hidden="true"><use href="#i-lock"/></svg></div><div><h2>Web interface password</h2><p>You’ll use this to sign in to your controller.</p></div></div>
          <label class="field">New password<input name="webPassword" type="password" required minlength="10" maxlength="128" autocomplete="new-password" placeholder="At least 10 characters"></label>
          <label class="field">Confirm password<input name="confirmation" type="password" required minlength="10" maxlength="128" autocomplete="new-password" placeholder="Enter it again"></label>
        </article>
        <p class="form-error" id="setup-error" role="alert"></p>
        <button class="btn setup-submit" id="setup-connect" type="submit">Save and connect<svg aria-hidden="true"><use href="#i-arrow"/></svg></button>
        <p class="hint inline-8">Keep this page open while connecting.</p>
      </form>
      <div class="setup-progress" id="setup-progress" role="status" hidden><svg aria-hidden="true"><use href="#i-wifi"/></svg><span>Connecting to your network…</span></div>
      <article class="panel setup-success" id="setup-success" hidden aria-labelledby="setup-success-heading">
        <div class="panel-icon inline-9"><svg aria-hidden="true"><use href="#i-check"/></svg></div>
        <h2 id="setup-success-heading" tabindex="-1">You’re connected</h2><p>Connected to <strong id="setup-connected-network"></strong>.</p>
        <ol><li>Reconnect your phone or computer to this Wi-Fi network.</li><li>Open the controller’s address and sign in with your new web password.</li></ol>
        <div class="setup-address mono" id="setup-address"></div>
        <p class="hint">The setup Wi-Fi closes automatically after saving.</p>
        <button class="btn" id="setup-finish" type="button">Continue<svg aria-hidden="true"><use href="#i-arrow"/></svg></button>
      </article>
    </div></div>
  </section>

  <template id="zone-template"><article class="zone-card"><div class="card-body"><div class="zone-top"><div class="zone-icon"><svg aria-hidden="true"><use class="room-icon" href="#i-sofa"/></svg></div></div><h2 class="zone-title"></h2><div class="stepper"><button class="adjust" type="button" data-step="-0.5">−</button><div class="temperature-display"><div class="temperature"><input type="number" step="0.5"><span class="unit-label">°C</span></div><output class="regular-temperature" hidden></output></div><button class="adjust" type="button" data-step="0.5">+</button></div><div class="segmented" role="group"><button type="button" data-mode="normal"><svg aria-hidden="true"><use href="#i-sun"/></svg>Normal</button><button type="button" data-mode="eco"><svg aria-hidden="true"><use href="#i-leaf"/></svg>Eco</button></div></div></article></template>
  <template id="zone-row-template"><button class="zone-row" type="button"><span class="zone-icon"><svg aria-hidden="true"><use class="room-icon" href="#i-sofa"/></svg></span><span class="zone-row-copy"><span class="zone-row-name"></span><span class="zone-meta"><span class="badge neutral zone-unit"></span><span class="badge neutral zone-offset"></span></span></span><span class="edit-label"><span>Edit</span><svg aria-hidden="true"><use href="#i-arrow"/></svg></span></button></template>

  <dialog id="password-dialog" aria-labelledby="password-title"><div class="dialog-body"><div class="dialog-heading"><h2 id="password-title">Change your password</h2><button class="icon-btn" type="button" data-close aria-label="Close"><svg aria-hidden="true"><use href="#i-close"/></svg></button></div><p class="dialog-intro">Use a unique password for the web interface. Your API token and Wi-Fi password stay unchanged.</p><form id="password-form"><label class="field">Current password<input name="current" type="password" required autocomplete="current-password"></label><label class="field">New password<input name="newPassword" type="password" required minlength="10" maxlength="128" autocomplete="new-password"><span class="hint">At least 10 characters.</span></label><label class="field">Confirm new password<input name="confirmation" type="password" required autocomplete="new-password"></label><p class="form-error" id="password-error" role="alert"></p><p class="hint">You’ll sign in again after changing it.</p><div class="dialog-actions"><button class="btn secondary" type="button" data-close>Cancel</button><button class="btn" type="submit">Update password</button></div></form></div></dialog>


  <dialog id="revoke-dialog" aria-labelledby="revoke-title"><div class="dialog-body"><div class="dialog-heading"><h2 id="revoke-title">Revoke API access?</h2><button class="icon-btn" type="button" data-close aria-label="Close"><svg aria-hidden="true"><use href="#i-close"/></svg></button></div><p class="dialog-intro">Home Assistant and scripts using this token will stop connecting immediately. You can generate another token later. Web sign-in stays available.</p><div class="dialog-actions"><button class="btn secondary" type="button" data-close>Keep token</button><button class="btn danger" id="confirm-revoke">Revoke token</button></div></div></dialog>
  <dialog id="zone-dialog" aria-labelledby="zone-dialog-title"><div class="dialog-body"><div class="dialog-heading"><h2 id="zone-dialog-title">Zone settings</h2><button class="icon-btn" type="button" data-close aria-label="Close"><svg aria-hidden="true"><use href="#i-close"/></svg></button></div><form id="zone-form"><label class="field">Zone name<input name="name" required maxlength="64" autocomplete="off"></label><fieldset class="room-icons"><legend>Room icon</legend><div class="icon-choices"><label class="icon-choice"><input type="radio" name="icon" value="sofa" required><svg aria-hidden="true"><use href="#i-sofa"/></svg><span>Living room</span></label><label class="icon-choice"><input type="radio" name="icon" value="bed" required><svg aria-hidden="true"><use href="#i-bed"/></svg><span>Bedroom</span></label><label class="icon-choice"><input type="radio" name="icon" value="desk" required><svg aria-hidden="true"><use href="#i-desk"/></svg><span>Office</span></label><label class="icon-choice"><input type="radio" name="icon" value="kitchen" required><svg aria-hidden="true"><use href="#i-kitchen"/></svg><span>Kitchen</span></label><label class="icon-choice"><input type="radio" name="icon" value="bathroom" required><svg aria-hidden="true"><use href="#i-bathroom"/></svg><span>Bathroom</span></label><label class="icon-choice"><input type="radio" name="icon" value="hallway" required><svg aria-hidden="true"><use href="#i-hallway"/></svg><span>Hallway</span></label></div></fieldset><label class="field">Unit<select name="unit"><option value="celsius">Celsius (°C)</option><option value="fahrenheit">Fahrenheit (°F)</option></select></label><p id="unit-target-note" class="hint inline-10" hidden></p><label class="field">Eco offset<input name="offset" type="number" min="-9" max="9" step="1" required><span class="hint">Used when Eco mode is selected.</span></label><p id="zone-error" class="form-error" role="alert"></p><div class="dialog-actions"><button class="btn secondary" type="button" data-close>Cancel</button><button class="btn" type="submit">Save zone</button></div></form><div id="zone-extra"><hr class="dialog-divider"><div class="row spread"><button class="btn secondary" id="pair-zone"><svg aria-hidden="true"><use href="#i-radio"/></svg>Pair a heater</button><button class="btn quiet inline-11" id="delete-zone">Delete zone</button></div></div></div></dialog>
  <dialog id="pair-dialog" aria-labelledby="pair-title"><div class="dialog-body"><div class="dialog-heading"><h2 id="pair-title">Add a heater</h2><button class="icon-btn" type="button" data-close aria-label="Close"><svg aria-hidden="true"><use href="#i-close"/></svg></button></div><p class="dialog-intro">Put the heater into learning mode, then start a 30-second pairing window. The controller repeats this zone’s current settings every 5 seconds.</p><div class="pairing-note" id="pair-progress" role="status">Ready to start pairing.</div><p class="hint inline-12">Verify success on the heater itself. A timer or radio acknowledgement does not confirm pairing.</p><div class="dialog-actions"><button class="btn secondary" type="button" id="stop-pair" hidden>Stop pairing</button><button class="btn" id="start-pair">Start pairing</button></div></div></dialog>
  <dialog id="delete-dialog" aria-labelledby="delete-title"><div class="dialog-body"><div class="dialog-heading"><h2 id="delete-title">Delete this zone?</h2><button class="icon-btn" type="button" data-close aria-label="Close"><svg aria-hidden="true"><use href="#i-close"/></svg></button></div><p class="dialog-intro">This removes the zone from the controller. It does not unpair its heaters or switch them off.</p><div class="dialog-actions"><button class="btn secondary" type="button" data-close>Keep zone</button><button class="btn danger" id="confirm-delete">Delete zone</button></div></div></dialog>
  <div class="toast" id="toast" role="status" aria-live="polite"></div>
  <noscript><p class="inline-13">JavaScript is required to use the controller.</p></noscript>
</body>
</html>
)HTML";
const char kStyle[] PROGMEM = R"CSS(:root{--paper:#f6f7f9;--white:#fff;--ink:#20292c;--muted:#647178;--line:#e4e9ea;--accent:#24594d;--accent-soft:#eef5f0;--brand-accent:#efb372;--nav:#182c2b;--red:#a84236;--radius:20px;font-family:Inter,ui-sans-serif,-apple-system,BlinkMacSystemFont,"Segoe UI",sans-serif;color:var(--ink);background:var(--paper);font-size:15px;font-synthesis:none}
    *{box-sizing:border-box}body{margin:0}button,input,select{font:inherit}button{cursor:pointer}button:disabled{cursor:not-allowed;opacity:.5}button,a,input,select{touch-action:manipulation}button,input,select{min-height:44px}button{transition:background .15s,transform .15s,box-shadow .15s}button:active:not(:disabled){transform:translateY(1px)}button:focus-visible,a:focus-visible{outline:3px solid #bc8140;outline-offset:4px}input:focus,select:focus{outline:3px solid #d5e6df;border-color:#628c7d}a{color:var(--accent)}[hidden]{display:none!important}h1,h2,h3,p{margin:0}h1{font-size:clamp(1.9rem,3.3vw,2.7rem);letter-spacing:-.055em;font-weight:650;line-height:1.12}h2{font-size:1.18rem;letter-spacing:-.025em;font-weight:650}h3{font-size:1rem;font-weight:600}p{line-height:1.6}svg{width:20px;height:20px;fill:none;stroke:currentColor;stroke-width:1.6;stroke-linecap:round;stroke-linejoin:round;flex-shrink:0}.sprite{position:absolute;width:0;height:0;overflow:hidden}.muted{color:var(--muted)}.small{font-size:.85rem}.eyebrow{font-size:.7rem;text-transform:uppercase;letter-spacing:.12em;font-weight:650}.row{display:flex;align-items:center;gap:12px}.spread{justify-content:space-between}.stack{display:grid;gap:8px}.mono{font-family:ui-monospace,SFMono-Regular,Consolas,monospace;font-size:.82rem;overflow-wrap:anywhere}.dot{width:6px;height:6px;background:#41795e;border-radius:50%;display:inline-block}.btn{border:1px solid transparent;border-radius:10px;padding:11px 17px;font-size:.87rem;font-weight:600;display:inline-flex;gap:8px;align-items:center;justify-content:center;white-space:nowrap;background:var(--accent);color:white}.btn:hover{background:#194538}.btn.secondary{background:white;border-color:var(--line);color:var(--ink);box-shadow:0 1px 2px #1e302908}.btn.secondary:hover{background:#f7f9f8;border-color:#bacbc4}.btn.quiet{background:transparent;color:var(--muted);padding-left:10px;padding-right:10px}.btn.quiet:hover{background:#eaf0ec;color:var(--accent)}.btn.danger{color:var(--red);background:#fff4f1;border-color:#f4d8d1}.icon-btn{display:inline-grid;place-items:center;border:0;background:transparent;border-radius:10px;color:var(--muted);width:44px;padding:0}.icon-btn:hover{background:#f1f4f3;color:var(--ink)}.badge{display:inline-flex;gap:7px;align-items:center;border:1px solid var(--line);border-radius:7px;padding:6px 9px;font-size:.72rem;font-weight:550;line-height:1.2;white-space:nowrap}.badge.green{color:#365e49;background:#f0f6ef;border-color:#ddeadd}.badge.neutral{color:#657176;background:#f3f5f6}.badge.amber{color:#875827;background:#fff7ec;border-color:#f3e3c9}
    .preview-bar{min-height:39px;background:#e9eeeb;color:#40594e;font-size:.72rem;display:flex;align-items:center;justify-content:center;gap:10px;padding:8px 16px;border-bottom:1px solid #dce4df;text-align:center}.preview-bar strong{font-weight:650}.preview-bar span{color:#708078}.shell{display:grid;grid-template-columns:238px minmax(0,1fr);min-height:calc(100dvh - 39px)}.sidebar{background:var(--nav);color:#c0d0c9;padding:34px 22px 23px;display:flex;flex-direction:column;gap:35px}.brand{display:flex;gap:11px;align-items:center;color:white}.brand-mark{width:37px;height:37px;display:flex;gap:4px;align-items:center;justify-content:center;background:#304440;border:1px solid #ffffff10;border-radius:11px;color:var(--brand-accent)}.brand-mark span{display:block;width:3px;height:20px;transform:skew(-13deg);border-radius:8px;background:currentColor}.brand-mark span:nth-child(2){height:26px}.brand-name{font-size:1.12rem;font-weight:550;letter-spacing:-.045em}.sidebar .eyebrow{color:#a8beb3;font-size:.62rem;margin:0 14px 12px}.nav{display:grid;gap:6px}.nav button{border:0;background:transparent;color:#bbcbc3;display:flex;align-items:center;gap:12px;border-radius:11px;padding:13px 14px;font-size:.88rem;text-align:left}.nav button:hover{background:#ffffff09}.nav button[aria-current=page]{background:#344b42;color:#f4f7ef}.nav button[aria-current=page]::after{content:"";width:5px;height:5px;background:var(--brand-accent);border-radius:50%;margin-left:auto}.sidebar-bottom{margin-top:auto;display:grid;gap:24px}.side-note{font-size:.75rem;line-height:1.7;color:#adc1b6;padding:0 12px}.sidebar .logout{justify-content:flex-start;color:#bdd0c6;font-weight:450;border-top:1px solid #ffffff12;border-radius:0;padding:18px 12px 0}.sidebar .logout:hover{background:none;color:white}.content{padding:0 44px 24px;max-width:1440px;width:100%;margin:auto}.page{padding-top:39px;animation:appear .24s ease}.page-heading{display:flex;align-items:center;justify-content:space-between;gap:22px;margin-bottom:29px}.page-heading p{margin-top:11px;color:var(--muted);font-size:.93rem}.summary-strip{display:flex;gap:28px;align-items:center;margin-bottom:25px;font-size:.79rem;color:var(--muted)}.summary-strip>span{display:flex;align-items:center;gap:7px}.summary-strip>span+span{padding-left:28px;border-left:1px solid var(--line)}.zone-grid{display:grid;grid-template-columns:repeat(3,minmax(0,1fr));gap:19px}.zone-card{border:1px solid var(--line);border-radius:var(--radius);background:white;overflow:hidden;box-shadow:0 4px 16px #28382d03}.zone-card .card-body{padding:23px 23px 20px}.zone-icon{width:39px;height:39px;border-radius:12px;background:#f6ede2;color:#9d7243;display:grid;place-items:center}.zone-card[data-mode=eco] .temperature input,.zone-card[data-mode=eco] .unit-label{color:var(--eco)}.zone-top{margin-bottom:23px}.zone-title{margin:17px 0 4px;font-size:1.03rem;letter-spacing:-.02em}.temperature-display{flex:1;min-width:0;position:relative}.regular-temperature{position:absolute;top:100%;left:0;width:100%;text-align:center;font-size:.8rem;line-height:1.5;color:var(--muted)}.stepper{display:flex;align-items:center;justify-content:space-between;gap:6px;margin:23px 0 26px}.stepper .adjust{height:38px;width:38px;min-height:38px;border:1px solid var(--line);border-radius:50%;background:white;color:#596663;font-size:1.45rem;font-weight:350;line-height:1}.stepper .adjust:hover{background:var(--accent-soft);border-color:#abc5b6}.temperature{display:flex;align-items:flex-start;justify-content:center;position:relative;gap:1px;flex:1;min-width:0}.temperature input{font-size:3.35rem;font-weight:400;letter-spacing:-.075em;color:var(--ink);background:none;border:0;padding:0;width:2.15em;line-height:1.2;text-align:center;font-variant-numeric:tabular-nums;border-radius:5px;appearance:textfield;-moz-appearance:textfield;min-width:0}.temperature input::-webkit-inner-spin-button{appearance:none}.temperature span{font-size:1rem;color:var(--muted);padding-top:9px;margin-left:-2px}.segmented{display:flex;gap:3px;background:#f0f2f2;padding:4px;border-radius:10px}.segmented button{border:0;flex:1;display:flex;align-items:center;justify-content:center;gap:7px;min-height:34px;background:transparent;border-radius:7px;font-size:.75rem;color:var(--muted)}.segmented svg{width:15px;height:15px}.segmented button[aria-pressed=true]{color:var(--accent);background:white;box-shadow:0 1px 5px #24392d10}.add-card{border:1px dashed #c7d2cd;border-radius:var(--radius);background:transparent;min-height:126px;display:flex;align-items:center;justify-content:center;gap:11px;color:#64776b;font-size:.82rem}.add-card:hover{background:#eef3ef;border-color:#8da792}.dashboard-bottom{margin-top:39px;display:flex;gap:16px;justify-content:space-between;padding:20px 0;border-top:1px solid var(--line);font-size:.71rem;color:var(--muted)}
    .tabs{display:flex;gap:28px;border-bottom:1px solid var(--line);margin-bottom:26px}.tabs button{border:0;border-bottom:2px solid transparent;background:none;color:var(--muted);padding:0 0 14px;font-size:.85rem}.tabs button[aria-selected=true]{color:var(--accent);border-bottom-color:var(--accent);font-weight:600}.settings-stack{display:grid;gap:20px;max-width:710px}.panel{border:1px solid var(--line);border-radius:var(--radius);background:white;padding:27px}.panel-heading{display:flex;gap:13px;align-items:flex-start;margin-bottom:23px}.panel-icon{background:#f1f4f1;color:#52685b;border-radius:10px;padding:10px;display:grid;place-items:center}.panel-heading h2{padding-top:1px;margin-bottom:6px}.panel-heading p{font-size:.82rem;color:var(--muted);max-width:430px}.setting-row{display:flex;align-items:center;justify-content:space-between;gap:16px;padding-top:20px;border-top:1px solid var(--line)}.setting-row p{font-size:.77rem;color:var(--muted);margin-top:5px}.setting-row h3{font-size:.88rem}.panel-bottom{margin-top:19px;display:flex;justify-content:space-between;gap:12px;align-items:center}.hint{font-size:.75rem;color:var(--muted);line-height:1.7}.wifi-layout{max-width:710px}.field{display:grid;gap:8px;margin-bottom:18px;font-size:.82rem;font-weight:550}.field input,.field select{width:100%;background:white;border:1px solid #d9e0dd;border-radius:9px;padding:11px 13px;color:var(--ink);font-size:.9rem;min-width:0}.field input::placeholder{color:#89928d}.field .hint{font-weight:400}.field-row{display:grid;grid-template-columns:1fr 1fr;gap:15px}.wifi-banner{display:flex;align-items:center;justify-content:space-between;background:#f3f7f1;border-radius:11px;padding:17px;margin-bottom:24px;color:#4e674a}.wifi-banner strong{font-size:.87rem}.facts{margin:0}.facts>div{display:flex;justify-content:space-between;gap:25px;padding:18px 0;border-bottom:1px solid var(--line);font-size:.84rem}.facts>div:last-child{border:0;padding-bottom:0}.facts dt{color:var(--muted)}.facts dd{margin:0;text-align:right}.security-topline{display:flex;align-items:center;gap:8px;margin-bottom:25px;color:#547257;font-size:.76rem}
    .login{min-height:calc(100dvh - 39px);display:grid;grid-template-columns:1fr 1fr}.login-art{background:var(--nav);color:#edf1e8;display:flex;flex-direction:column;justify-content:space-between;padding:54px 13%;position:relative;overflow:hidden}.login-copy{position:relative;z-index:1;padding:80px 0 65px}.login-copy h1{font-size:clamp(2.5rem,5.2vw,4.6rem);font-weight:400;letter-spacing:-.06em;line-height:1.06}.login-copy p{margin-top:24px;color:#afc2b5;max-width:280px;font-size:.91rem;line-height:1.9}.rings{position:absolute;right:-205px;bottom:-290px;width:700px;height:700px;border:1px solid #bdd1b213;border-radius:50%;box-shadow:0 0 0 65px #bdd1b207,0 0 0 130px #bdd1b207,0 0 0 195px #bdd1b205}.login-form-wrap{display:flex;align-items:center;justify-content:center;padding:45px 32px;background:#fbfcfa}.login-form-inner{max-width:355px;width:100%}.login-form-inner h2{font-size:1.7rem;letter-spacing:-.05em;margin-bottom:9px}.login-form-inner>p{font-size:.9rem;color:var(--muted);margin-bottom:30px}.login-form-inner .btn{width:100%}.login-lock{width:50px;height:50px;border-radius:15px;display:grid;place-items:center;background:#eaf0e8;color:#4d6e55;margin-bottom:24px}.login-demo{border:1px dashed #d6dfd3;border-radius:10px;padding:15px;margin-top:27px;font-size:.76rem;color:#667762;line-height:1.8}.login-demo code{color:#3d5a44}.login-warning{margin-top:18px;font-size:.71rem;line-height:1.7;color:#8b7960}.form-error{color:var(--red);font-size:.82rem;line-height:1.6;margin:10px 0}.form-error:empty{display:none}
    dialog{border:1px solid var(--line);border-radius:23px;padding:0;width:min(480px,calc(100% - 32px));max-height:calc(100dvh - 40px);color:var(--ink);background:white;box-shadow:0 30px 90px #152c3030;animation:appear .17s ease}dialog::backdrop{background:#12272366;backdrop-filter:blur(4px)}.dialog-body{padding:28px}.dialog-heading{display:flex;align-items:flex-start;justify-content:space-between;gap:12px;margin-bottom:20px}.dialog-heading h2{font-size:1.32rem;margin-top:8px}.dialog-heading .icon-btn{margin-right:-10px;margin-top:-2px}.dialog-intro{font-size:.84rem;color:var(--muted);margin-bottom:22px;line-height:1.7}.dialog-actions{display:flex;justify-content:flex-end;gap:9px;margin-top:23px}.dialog-divider{border:0;border-top:1px solid var(--line);margin:23px 0}.token-value{font-family:ui-monospace,monospace;font-size:.78rem;width:100%;padding:14px;background:#f1f5ef;border:1px solid #dce6d7;border-radius:10px;resize:none;line-height:1.8;overflow-wrap:anywhere;word-break:break-all;min-height:87px;color:#365037}.token-display{margin-top:20px}.token-display .field{margin-bottom:10px}.toast{position:fixed;bottom:25px;left:50%;transform:translateX(-50%);background:#203c32;color:#fff;border:1px solid #5a726530;box-shadow:0 5px 20px #16332520;padding:14px 20px;border-radius:12px;font-size:.83rem;max-width:calc(100% - 32px);width:max-content;z-index:10;line-height:1.6}.toast:empty{display:none}.pairing-note{padding:14px;border-radius:10px;background:#f2f6ee;color:#54704c;font-size:.82rem;line-height:1.7}.prototype-reset{border:0;background:none;color:inherit;font:inherit;text-decoration:underline;text-underline-offset:3px;min-height:0;padding:0}.empty{grid-column:1/-1;text-align:center;padding:35px;border:1px solid var(--line);border-radius:20px;color:var(--muted)}
    /* Original palette, also used by the initial setup preview. */
    :root{color-scheme:light;--eco:#24594d;--nav-ink:#edf1e8;--nav-text:#afc2b5;--icon-ink:#9d7243;--accent-border:#abc5b6;--focus:#bc8140}
    .preview-bar{flex-wrap:wrap}
    .preview-picker{display:flex;align-items:center;gap:8px;margin-left:12px;font-weight:550}
    .preview-picker select{min-height:44px;max-width:170px;padding:7px 28px 7px 11px;background:white;border:1px solid var(--accent-border);border-radius:8px;color:var(--ink);font-size:.78rem}
    .onboarding{flex:1;min-height:0;display:grid;grid-template-columns:minmax(260px,.75fr) minmax(0,1.5fr);overflow-y:auto}
    .setup-intro{background:var(--nav);color:var(--nav-ink);padding:42px;display:flex;flex-direction:column;gap:60px}
    .setup-intro h1{font-size:clamp(2rem,3.1vw,3rem);max-width:310px}
    #setup-heading:focus,#setup-success-heading:focus{outline:none}
    .setup-intro p{color:var(--nav-text);font-size:.9rem;margin-top:20px;max-width:310px}
    .setup-steps{list-style:none;padding:0;margin:30px 0 0;display:grid;gap:20px;font-size:.84rem;color:var(--nav-text)}
    .setup-steps li{display:flex;align-items:center;gap:12px}
    .setup-steps svg{color:var(--brand-accent)}
    .setup-tagline{margin-top:auto;font-size:.8rem;line-height:1.8;color:var(--nav-text)}
    .setup-content{padding:40px;min-width:0}
    .setup-inner{max-width:650px;margin:0 auto}
    .setup-content .panel{margin-bottom:18px}
    .setup-content .panel-heading{margin-bottom:20px}
    .setup-content .field:last-child{margin-bottom:0}
    .setup-network-row{display:flex;gap:16px;justify-content:space-between;align-items:center;flex-wrap:wrap;margin-bottom:18px}
    .setup-submit{width:100%}
    .setup-progress{padding:20px 0;display:flex;gap:12px;align-items:center;color:var(--accent);font-size:.87rem}
    .setup-progress svg{animation:appear .8s ease infinite alternate}
    .setup-success h2{font-size:1.7rem;margin:18px 0 12px}
    .setup-success p{font-size:.9rem;color:var(--muted);margin-bottom:18px}
    .setup-success ol{padding-left:21px;font-size:.88rem;color:var(--muted);line-height:1.8;margin:20px 0 25px}
    .setup-address{background:var(--accent-soft);border:1px solid var(--line);border-radius:10px;padding:15px;margin:18px 0;color:var(--accent)}
    @media(max-width:900px){.onboarding{grid-template-columns:1fr}.setup-intro{padding:24px;gap:25px}.setup-intro h1{max-width:none;font-size:2rem}.setup-intro p{max-width:none;margin-top:12px}.setup-steps,.setup-tagline{display:none}.setup-content{padding:25px 20px}}
    @keyframes appear{from{opacity:0;transform:translateY(6px)}to{opacity:1;transform:translateY(0)}}
    @media(min-width:1500px){.content{padding-left:62px;padding-right:62px}.zone-card .card-body{padding:26px}.zone-grid{gap:24px}}
    @media(max-width:1180px){.shell{grid-template-columns:205px minmax(0,1fr)}.content{padding-left:28px;padding-right:28px}.sidebar{padding-left:15px;padding-right:15px}.zone-grid{grid-template-columns:repeat(2,minmax(0,1fr))}.zone-card .card-body{padding:22px}}
    @media(max-width:700px){.preview-bar{font-size:.65rem;gap:7px;flex-wrap:wrap}.preview-bar .preview-detail{display:none}.shell{display:block}.sidebar{padding:18px 20px 12px;gap:19px}.brand-name{font-size:1rem}.brand-mark{width:31px;height:31px}.brand-mark span{height:17px}.brand-mark span:nth-child(2){height:22px}.sidebar .eyebrow,.side-note{display:none}.nav{display:flex;gap:8px}.nav button{flex:1;justify-content:center;padding:10px}.nav button[aria-current=page]::after{display:none}.sidebar-bottom{position:absolute;right:14px;top:53px}.sidebar .logout{border:0;font-size:0;padding:5px;width:42px;min-height:42px}.sidebar .logout svg{width:19px}.content{padding:0 20px 20px}.page{padding-top:27px}.page-heading{margin-bottom:24px;align-items:flex-start}.page-heading p{font-size:.83rem;max-width:220px}.page-heading .btn{font-size:.78rem;padding:10px 13px;min-height:42px}.page-heading .btn svg{width:15px}.zone-grid{grid-template-columns:1fr;gap:16px}.zone-card .card-body{padding:22px 24px}.zone-title{margin-top:13px}.zone-top{margin-bottom:13px}.stepper{margin:18px 0 24px;max-width:260px;margin-left:auto;margin-right:auto}.temperature input{font-size:3.7rem}.add-card{min-height:80px}.summary-strip{gap:14px;font-size:.72rem}.summary-strip>span+span{padding-left:14px}.dashboard-bottom{flex-direction:column;gap:9px;margin-top:28px}.panel{padding:22px 19px}.panel-heading{gap:10px}.panel-icon{padding:8px}.panel-heading h2{font-size:1.07rem}.panel-heading p{font-size:.8rem}.setting-row{align-items:flex-start;flex-wrap:wrap}.setting-row .btn{font-size:.79rem}.panel-bottom{align-items:flex-start;flex-wrap:wrap}.tabs{gap:25px}.field-row{grid-template-columns:1fr;gap:0}.login{display:block}.login-art{padding:25px 28px;min-height:0}.login-copy,.rings{display:none}.login-form-wrap{padding:44px 27px;min-height:calc(100dvh - 130px)}.facts>div{gap:15px;flex-wrap:wrap}.facts dd{text-align:left}.dialog-body{padding:23px}.toast{bottom:16px;font-size:.78rem}}
    @media(max-width:700px){.page-heading{display:block}.page-heading p{max-width:none}.page-heading>.btn{margin-top:17px}}
    .room-icons{border:0;padding:0;margin:0 0 19px;min-width:0}
    .room-icons legend{font-size:.82rem;font-weight:550;padding:0;margin-bottom:9px}
    .icon-choices{display:grid;grid-template-columns:repeat(3,minmax(0,1fr));gap:8px}
    .icon-choice{position:relative;display:flex;flex-direction:column;align-items:center;justify-content:center;gap:7px;min-height:76px;padding:10px 4px;border:1px solid var(--line);border-radius:10px;color:var(--muted);font-size:.72rem;text-align:center;cursor:pointer}
    .icon-choice input{position:absolute;width:1px;height:1px;min-height:0;opacity:0}
    .icon-choice svg{color:var(--icon-ink)}
    .icon-choice:hover{background:var(--accent-soft)}
    .icon-choice:has(input:checked){background:var(--accent-soft);border-color:var(--accent-border);color:var(--accent)}
    .icon-choice:has(input:focus-visible){outline:3px solid var(--focus);outline-offset:3px}
    .dialog-actions,.dialog-body .row.spread{flex-wrap:wrap}
    /* Only the main pane scrolls; sign-out lives in Settings > Security. */
    body{height:100dvh;display:flex;flex-direction:column;overflow:hidden}
    .preview-bar{flex-shrink:0}
    .shell{flex:1;min-height:0}
    .sidebar{min-height:0;gap:24px}
    .sidebar-main{display:grid;align-content:start;gap:35px;min-height:0;overflow-y:auto}
    .sidebar-bottom{flex-shrink:0}
    .brand-mark{flex-shrink:0}
    .content{height:100%;overflow-y:auto;overscroll-behavior:contain;margin:0 auto}
    .login{flex:1;min-height:0;overflow-y:auto}
    @media(max-width:700px){
      .shell{display:flex;flex-direction:column}
      .sidebar{flex-shrink:0}
      .sidebar-main{display:flex;flex-direction:column;gap:19px;overflow:visible}
      .sidebar-bottom{display:none}
      .content{height:auto;flex:1;min-height:0}
      .toast{bottom:calc(16px + env(safe-area-inset-bottom,0px))}
    }
    @media(prefers-reduced-motion:reduce){*,*::before,*::after{animation:none!important;transition:none!important;scroll-behavior:auto!important}}

.inline-1{width:15px;height:15px}
.inline-2{width:12px;height:12px}
.inline-3{margin-top:12px}
.inline-4{margin-top:10px}
.inline-5{margin-top:17px}
.inline-6{margin-bottom:15px}
.inline-7{margin-top:20px}
.inline-8{margin-top:12px}
.inline-9{width:fit-content}
.inline-10{margin-top:-5px;margin-bottom:18px}
.inline-11{color:var(--red)}
.inline-12{margin-top:17px}
.inline-13{padding:24px}
.shell,.login{min-height:0}.loading{margin:auto;padding:24px;text-align:center}.loading button{margin:20px auto}.toast.error{background:#89372d}.temperature input:disabled{opacity:.7}.setup-progress{scroll-margin:20px}.field textarea{font:inherit}button:disabled{pointer-events:none}
.settings-stack{max-width:760px}
.section-heading{display:flex;justify-content:space-between;align-items:center;gap:20px;margin-bottom:20px}
.section-heading p{font-size:.82rem;color:var(--muted);margin-top:7px}
.zone-list{display:grid;border:1px solid var(--line);border-radius:16px;overflow:hidden}
.zone-row{border:0;border-bottom:1px solid var(--line);background:white;display:flex;align-items:center;gap:17px;width:100%;text-align:left;padding:21px 20px;color:var(--ink)}
.zone-row:last-child{border-bottom:0}.zone-row:hover{background:#f8faf9}
.zone-row .zone-icon{flex-shrink:0}.zone-row-copy{flex:1;min-width:0}
.zone-row-name{display:block;font-size:.96rem;font-weight:600;overflow-wrap:anywhere}
.zone-meta{display:flex;gap:8px;flex-wrap:wrap;margin-top:9px}
.edit-label{display:flex;align-items:center;gap:7px;color:var(--accent);font-size:.81rem;flex-shrink:0}.edit-label svg{width:16px}
.zone-list-footer{margin-top:16px;color:var(--muted);font-size:.76rem}
.session-panel .setting-row{border:0;padding:0}.session-title{display:flex;gap:13px;align-items:center}
@media(max-width:700px){
  .tabs{justify-content:space-between;gap:12px}.tabs button{font-size:.81rem}
  .section-heading{align-items:flex-start;flex-wrap:wrap;gap:16px}.section-heading .btn{font-size:.79rem;padding:10px 13px}
  .zone-row{padding:19px 15px;gap:12px}.zone-meta{gap:5px}.zone-meta .badge{font-size:.68rem;padding:5px 7px}
  .edit-label span{display:none}.zone-row-name{font-size:.89rem}.zone-row .zone-icon{width:35px;height:35px}
}
)CSS";
const char kScript[] PROGMEM = R"JS('use strict';

// Testable asynchronous state machines; mutations are never retried after an
// ambiguous response. The controller owns the ten-second RF grace period.
class ZoneWriter {
  constructor(send, changed, failed) { this.send = send; this.changed = changed; this.failed = failed; this.jobs = new Map(); }
  busy(id) { return this.jobs.has(id); }
  queue(id, fields) {
    const existing = this.jobs.get(id);
    if (existing) { Object.assign(existing.next, fields); return existing.promise; }
    const job = {next:{...fields}}; this.jobs.set(id, job);
    job.promise = this.run(id, job); return job.promise;
  }
  async run(id, job) {
    try {
      while (Object.keys(job.next).length) {
        const fields = job.next; job.next = {};
        await this.send(id, fields);
      }
      this.changed(id);
    } catch (error) { job.next = {}; this.failed(id, error); }
    finally { this.jobs.delete(id); }
  }
}
class NetworkFlow {
  constructor(request, changed) {
    this.request = request; this.changed = changed; this.generation = 0;
    this.status = null; this.networks = []; this.starting = false; this.submitting = false;
    this.scanning = false; this.pending = true; this.polling = false; this.error = '';
  }
  busy() { return !this.status || this.starting || this.submitting || this.scanning || !['setup','configured'].includes(this.status.state); }
  async poll() {
    if (this.polling) return;
    this.polling = true;
    try {
      const generation = this.generation;
      const status = await this.request('/ui/network');
      if (generation !== this.generation) return;
      this.status = status;
      if (generation === this.generation && !this.starting) this.scanning = status.scanning;
      if (this.scanning) this.pending = true;
      this.changed(this);
      if (this.pending && !this.starting) {
        const resultGeneration = this.generation;
        const result = await this.request('/ui/networks');
        if (resultGeneration !== this.generation || this.starting) return;
        this.networks = result.networks; this.scanning = result.scanning; this.pending = this.scanning;
        this.error = ''; this.changed(this);
      }
    } finally { this.polling = false; }
  }
  async scan() {
    if (this.busy()) return;
    this.starting = true; this.pending = true; ++this.generation; this.error = ''; this.changed(this);
    try { await this.request('/ui/network/scan', 'POST', {}); this.scanning = true; }
    catch (error) { this.error = error.message; throw error; }
    finally { this.starting = false; this.changed(this); }
  }
  async connect(value) {
    if (this.busy()) throw new Error('Wait for the current network operation to finish.');
    ++this.generation; this.submitting = true; this.changed(this);
    try { await this.request('/ui/network', 'POST', value); }
    finally {
      // Keep competing submissions locked until a status read reconciles them.
      this.status = null; this.submitting = false; this.changed(this);
    }
  }
}
function limits(unit) { return unit === 'celsius' ? [10,30] : [50,86]; }
function validTarget(value, unit) { const [low,high] = limits(unit); return Number.isFinite(value) && value >= low && value <= high && Number.isInteger(value * 2); }
function convertedTarget(target, from, to) { return target === null || from === to ? target : Math.round((to === 'celsius' ? (target-32)*5/9 : target*9/5+32)*2)/2; }
const MAX_ZONES = 8;
function nextTabIndex(key, at, count) { return key === 'ArrowRight' ? (at+1)%count : key === 'ArrowLeft' ? (at+count-1)%count : key === 'Home' ? 0 : key === 'End' ? count-1 : -1; }

if (typeof module !== 'undefined') module.exports = {ZoneWriter, NetworkFlow, limits, validTarget, convertedTarget, MAX_ZONES, nextTabIndex};
if (typeof document !== 'undefined') startInterface();

function startInterface() {
  const $ = id => document.getElementById(id);
  const state = {authenticated:false, configured:true, portal:false, nonce:'', page:'zones', tab:'zones', zones:[], icons:{}, token:'', editing:null, pairing:null, pairingWindows:new Map(), uncertain:new Set()};
  let noticeTimer, refreshBusy = false, stopped = false, booting = false, setupSubmitting = false, tokenBusy = false, tokenVersion = 0, setupSaved = false, passwordWork = 0;
  const flow = new NetworkFlow(request, renderNetwork);
  const writer = new ZoneWriter((id, value) => request('/ui/api/v1/zones/' + id, 'PATCH', value),
    () => notice('Saved to controller.'), (id,error) => { state.uncertain.add(id); renderZones(); notice(error.message, true); });
  function notice(message, error = false) {
    clearTimeout(noticeTimer); $('toast').textContent = message; $('toast').className = 'toast' + (error ? ' error' : '');
    if (!error) noticeTimer = setTimeout(() => { $('toast').textContent = ''; }, 5000);
  }
  function closeDialogs() { for (const dialog of document.querySelectorAll('dialog[open]')) dialog.close(); }
  function clearPrivate() {
    ++tokenVersion; state.pairingWindows.clear();
    state.authenticated = false; state.token = ''; state.zones = []; state.icons = {}; state.uncertain.clear();
    $('zone-grid').replaceChildren(); $('zone-list').replaceChildren(); $('zone-count').textContent = '';
    $('token-value').value = ''; $('token-display').hidden = true;
    for (const input of document.querySelectorAll('input[type=password]')) input.value = '';
    closeDialogs();
  }
  async function request(path, method = 'GET', body) {
    const passwordRequest = method === 'POST' && ['/ui/enroll','/ui/login','/ui/password'].includes(path);
    if (passwordRequest) ++passwordWork;
    const abort = new AbortController(), timeout = setTimeout(() => abort.abort(), passwordRequest ? 65000 : 12000);
    try {
      const response = await fetch(path, {method, credentials:'same-origin', cache:'no-store', signal:abort.signal,
        headers:{...(body === undefined ? {} : {'Content-Type':'application/json'}), ...(method === 'GET' ? {} : {'X-Connex-Nonce':state.nonce})},
        body:body === undefined ? undefined : JSON.stringify(body)});
      const value = [202,204].includes(response.status) ? null : await response.json();
      if (!response.ok) {
        if (response.status === 401 && path !== '/ui/login' && path !== '/ui/password' && path !== '/ui/session') {
          clearPrivate();
          // A physical reset or closed setup portal can change the entry screen.
          // Reconcile by reading session state; never repeat the failed mutation.
          try { Object.assign(state, await request('/ui/session')); } catch {}
          display();
        }
        const error = new Error(value?.error?.message || 'The controller rejected the request.'); error.status = response.status; throw error;
      }
      return value;
    } catch (error) {
      if (error.status) throw error;
      throw new Error(method === 'GET' ? 'Connection interrupted. Check your Wi-Fi and refresh.' : 'Change not confirmed. Refresh to check the saved state before trying again.');
    } finally { clearTimeout(timeout); if (passwordRequest) --passwordWork; }
  }
  function display() {
    const setup = state.portal, needsSetup = !state.configured && !setup;
    $('loading-view').hidden = true; $('setup-view').hidden = !setup;
    $('app-shell').hidden = setup || !state.authenticated;
    $('login-view').hidden = setup || state.authenticated;
    $('setup-password-panel').hidden = state.configured;
    $('login-form').hidden = needsSetup;
    $('login-heading').textContent = needsSetup ? 'Setup required' : 'Sign in';
    $('login-description').textContent = needsSetup ? 'Hold the Setup button for five seconds, then join the controller’s setup Wi-Fi to configure Wi-Fi and a password.' : 'Sign in to your local controller.';
    renderNetwork();
    for (const page of ['zones','settings']) {
      $('page-' + page).hidden = state.page !== page;
      const button = document.querySelector('[data-page=' + page + ']');
      if (state.page === page) button.setAttribute('aria-current','page'); else button.removeAttribute('aria-current');
    }
  }
  async function boot() {
    if (booting) return; booting = true; stopped = false;
    try {
      const session = await request('/ui/session'); Object.assign(state, session);
      display();
      if (state.authenticated && !state.portal) await refresh();
      if (state.portal || state.authenticated) await flow.poll();
    } catch (error) { notice(error.message, true); $('retry-load').hidden = false; }
    finally { booting = false; }
  }
  $('retry-load').addEventListener('click', boot);
  async function refresh() {
    if (refreshBusy || writer.jobs.size) return;
    refreshBusy = true; $('refresh').disabled = true; renderZones();
    try {
      const device = await request('/ui/api/v1/device');
      $('device-id').textContent = device.id; $('firmware-version').textContent = device.firmware_version;
      $('device-health').textContent = device.health; $('api-url').textContent = location.origin + '/api/v1';
      const zones = await request('/ui/api/v1/zones'), icons = await request('/ui/icons');
      if (!state.authenticated) return;
      state.icons = icons.icons; state.zones = zones.zones; state.uncertain.clear(); renderZones();
    } finally { refreshBusy = false; $('refresh').disabled = false; renderZones(); }
  }
  $('refresh').addEventListener('click', () => refresh().catch(e => notice(e.message, true)));
  for (const button of document.querySelectorAll('[data-close]')) button.addEventListener('click', () => button.closest('dialog').close());
  for (const button of document.querySelectorAll('[data-page]')) button.addEventListener('click', () => {
    state.page = button.dataset.page; display(); document.querySelector('.content').scrollTop = 0;
    if (state.page === 'settings') loadToken().catch(e => notice(e.message, true));
  });
  function tab(name) {
    state.tab = name;
    for (const button of document.querySelectorAll('[data-tab]')) {
      const active = button.dataset.tab === name;
      button.setAttribute('aria-selected',String(active)); button.tabIndex = active ? 0 : -1;
      $('settings-' + button.dataset.tab).hidden = !active;
    }
  }
  const tabs = [...document.querySelectorAll('[data-tab]')];
  for (const button of tabs) {
    button.addEventListener('click', () => tab(button.dataset.tab));
    button.addEventListener('keydown', event => {
      const next = nextTabIndex(event.key, tabs.indexOf(button), tabs.length);
      if (next >= 0) { event.preventDefault(); tab(tabs[next].dataset.tab); tabs[next].focus(); }
    });
  }
  function lockForm(form, locked) { for (const field of form.elements) field.disabled = locked; }
  $('login-form').addEventListener('submit', async event => {
    event.preventDefault(); const form = event.currentTarget; if (form.querySelector('button').disabled) return;
    const password = $('login-password').value; lockForm(form, true); $('login-error').textContent = '';
    try { await request('/ui/login','POST',{password}); form.reset(); await boot(); }
    catch (error) { $('login-error').textContent = error.message; }
    finally { $('login-password').value = ''; lockForm(form, false); }
  });
  $('sign-out').addEventListener('click', async () => {
    $('sign-out').disabled = true;
    try { await request('/ui/logout','POST',{}); clearPrivate(); display(); }
    catch (error) { clearPrivate(); display(); notice('Sign-out not confirmed. The server session may still be active. Reconnect and sign in, then change your password to end all sessions.',true); }
    finally { $('sign-out').disabled = false; }
  });
  function renderZones() {
    $('zone-grid').replaceChildren(); $('zone-list').replaceChildren();
    $('zone-count').textContent = state.zones.length + ' of ' + MAX_ZONES + ' zones';
    $('add-zone').disabled = refreshBusy || state.zones.length >= MAX_ZONES;
    for (const zone of state.zones) {
      const card = $('zone-template').content.firstElementChild.cloneNode(true), config = zone.configuration;
      card.dataset.id = zone.id; card.dataset.mode = config.mode;
      card.querySelector('.zone-title').textContent = zone.name;
      card.querySelector('.room-icon').setAttribute('href','#i-' + (state.icons[zone.id] || 'sofa'));
      const input = card.querySelector('input'), offset = config.mode === 'eco' ? config.eco_offset : 0, unit = config.unit === 'celsius' ? '°C' : '°F';
      input.value = config.target_temperature === null ? '' : (config.target_temperature + offset).toFixed(1);
      input.placeholder = '—'; input.min = limits(config.unit)[0] + offset; input.max = limits(config.unit)[1] + offset;
      input.setAttribute('aria-label',zone.name + (config.mode === 'eco' ? ' effective Eco temperature' : ' temperature'));
      input.disabled = refreshBusy || state.uncertain.has(zone.id);
      card.querySelector('.unit-label').textContent = unit;
      const regular = card.querySelector('.regular-temperature'); regular.hidden = config.mode !== 'eco' || config.target_temperature === null;
      regular.textContent = config.target_temperature === null ? '' : config.target_temperature.toFixed(1) + unit;
      input.addEventListener('change', () => setTarget(zone, input.value === '' ? NaN : Number(input.value) - offset));
      for (const button of card.querySelectorAll('[data-step]')) {
        const delta = Number(button.dataset.step), value = config.target_temperature === null ? (config.unit === 'celsius' ? 21 : 70) : config.target_temperature + delta;
        button.disabled = refreshBusy || state.uncertain.has(zone.id) || !validTarget(value,config.unit);
        button.setAttribute('aria-label',(delta > 0 ? 'Increase ' : 'Decrease ') + zone.name + ' temperature');
        button.addEventListener('click', () => setTarget(zone,value));
      }
      for (const button of card.querySelectorAll('[data-mode]')) {
        button.setAttribute('aria-pressed',String(button.dataset.mode === config.mode));
        button.disabled = refreshBusy || state.uncertain.has(zone.id) || config.target_temperature === null;
        button.addEventListener('click', () => { if (refreshBusy) return; config.mode = button.dataset.mode; renderZones(); writer.queue(zone.id,{mode:config.mode}); });
      }
      $('zone-grid').append(card);
      const row = $('zone-row-template').content.firstElementChild.cloneNode(true);
      row.dataset.id = zone.id; row.disabled = refreshBusy;
      row.setAttribute('aria-label','Edit ' + zone.name);
      row.querySelector('.room-icon').setAttribute('href','#i-' + (state.icons[zone.id] || 'sofa'));
      row.querySelector('.zone-row-name').textContent = zone.name;
      row.querySelector('.zone-unit').textContent = config.unit === 'celsius' ? 'Celsius' : 'Fahrenheit';
      row.querySelector('.zone-offset').textContent = 'Eco offset ' + (config.eco_offset > 0 ? '+' : '') + config.eco_offset + unit;
      row.addEventListener('click', () => editZone(zone.id)); $('zone-list').append(row);
    }
    if (!state.zones.length) {
      for (const id of ['zone-grid','zone-list']) {
        const empty = document.createElement('p'); empty.className = 'empty';
        empty.textContent = id === 'zone-grid' ? 'No zones yet. Add one in Settings.' : 'No zones yet.';
        $(id).append(empty);
      }
    }
  }
  function setTarget(zone, value) {
    if (refreshBusy) return;
    if (!validTarget(value,zone.configuration.unit)) { renderZones(); notice('Use a supported temperature in half-degree steps.',true); return; }
    zone.configuration.target_temperature = value; renderZones(); writer.queue(zone.id,{target_temperature:value});
  }
  function editZone(id) {
    if (refreshBusy || (!id && state.zones.length >= MAX_ZONES)) return;
    if (id && (writer.busy(id) || state.uncertain.has(id))) { notice('Refresh after pending changes finish before editing this zone.',true); return; }
    state.editing = id; const zone = state.zones.find(z => z.id === id), form = $('zone-form');
    form.reset(); form.elements.name.value = zone?.name || ''; form.elements.icon.value = state.icons[id] || 'sofa';
    form.elements.unit.value = zone?.configuration.unit || 'celsius'; form.elements.offset.value = zone?.configuration.eco_offset || 0;
    for (const name of ['unit','offset']) form.elements[name].closest('label').hidden = !zone || zone.configuration.target_temperature === null;
    $('zone-dialog-title').textContent = zone ? 'Zone settings' : 'Add zone'; $('zone-extra').hidden = !zone;
    $('zone-error').textContent = ''; unitNote(); $('zone-dialog').showModal();
  }
  function unitNote() {
    const zone = state.zones.find(z => z.id === state.editing), selected = $('zone-form').elements.unit.value;
    const target = zone ? convertedTarget(zone.configuration.target_temperature,zone.configuration.unit,selected) : null;
    $('unit-target-note').hidden = !zone || selected === zone.configuration.unit || target === null;
    $('unit-target-note').textContent = 'Converted target: ' + target + (selected === 'celsius' ? '°C' : '°F') + '. Review the Eco offset in the new unit.';
  }
  $('add-zone').addEventListener('click', () => editZone(null)); $('zone-form').elements.unit.addEventListener('change',unitNote);
  $('zone-form').addEventListener('submit', async event => {
    event.preventDefault(); const form = event.currentTarget; if (form.querySelector('[type=submit]').disabled) return;
    if (refreshBusy) { $('zone-error').textContent = 'Wait for the current refresh to finish.'; return; }
    const value = {name:form.elements.name.value.trim(),unit:form.elements.unit.value,offset:Number(form.elements.offset.value),icon:form.elements.icon.value};
    const old = state.zones.find(z => z.id === state.editing);
    let created = false, saved = false; lockForm(form,true); $('zone-error').textContent = '';
    try {
      if (!value.name || !Number.isInteger(value.offset) || Math.abs(value.offset) > 9) throw new Error('Enter a name and an integer Eco offset from −9 to +9.');
      if (!old) {
        const result = await request('/ui/api/v1/zones','POST',{name:value.name}); state.editing = result.id; created = true;
        // Creation saves defaults without RF; pairing or control updates dispatch them.
      } else {
        const patch = {}; if (value.name !== old.name) patch.name = value.name;
        if (value.unit !== old.configuration.unit) {
          const target = convertedTarget(old.configuration.target_temperature,old.configuration.unit,value.unit);
          if (!validTarget(target,value.unit)) throw new Error('Set a target on the Zones screen before changing the unit.');
          patch.unit = value.unit; patch.target_temperature = target;
        }
        if (value.offset !== old.configuration.eco_offset) patch.eco_offset = value.offset;
        if (Object.keys(patch).length) await request('/ui/api/v1/zones/' + old.id,'PATCH',patch);
      }
      saved = true; await request('/ui/icons','PATCH',{id:state.editing,icon:value.icon});
      $('zone-dialog').close(); await refresh(); notice('Saved to controller.');
    } catch (error) {
      $('zone-error').textContent = (saved ? 'Zone saved; icon update needs attention. ' : created ? 'Zone was created. ' : '') + error.message;
      if (created) { $('zone-dialog').close(); notice($('zone-error').textContent,true); }
      await refresh().catch(() => {});
    } finally { lockForm(form,false); }
  });
  $('delete-zone').addEventListener('click', () => { $('zone-dialog').close(); $('delete-dialog').showModal(); });
  $('confirm-delete').addEventListener('click', async () => {
    $('confirm-delete').disabled = true;
    try { await request('/ui/api/v1/zones/' + state.editing,'DELETE'); $('delete-dialog').close(); await refresh(); notice('Zone deleted.'); }
    catch (error) { notice(error.message,true); } finally { $('confirm-delete').disabled = false; }
  });
  $('pair-zone').addEventListener('click', () => {
    state.pairing = state.editing; $('zone-dialog').close(); $('pair-dialog').showModal(); pairingStatus();
  });
  function pairingStatus() {
    const seconds = Math.max(0,Math.ceil(((state.pairingWindows.get(state.pairing) || 0)-Date.now())/1000));
    $('pair-progress').textContent = seconds ? 'Pairing window: ' + seconds + 's remaining. Verify success on the heater.' : 'Put the heater in learning mode, then start pairing.';
    $('start-pair').hidden = seconds > 0; $('stop-pair').hidden = false;
  }
  for (const [id,method,body] of [['start-pair','POST',{duration_seconds:30}],['stop-pair','DELETE',undefined]]) {
    $(id).addEventListener('click', async () => {
      const zone = state.pairing;
      $('start-pair').disabled = $('stop-pair').disabled = true;
      try { await request('/ui/api/v1/zones/' + zone + '/pairing',method,body); state.pairingWindows.set(zone,method === 'POST' ? Date.now()+30000 : 0); pairingStatus(); }
      catch (error) { notice(error.message,true); }
      finally { $('start-pair').disabled = $('stop-pair').disabled = false; }
    });
  }
  $('change-password').addEventListener('click', () => { $('password-form').reset(); $('password-error').textContent = ''; $('password-dialog').showModal(); });
  $('password-form').addEventListener('submit', async event => {
    event.preventDefault(); const form = event.currentTarget; if (form.querySelector('[type=submit]').disabled) return;
    if (form.elements.newPassword.value !== form.elements.confirmation.value) { $('password-error').textContent = 'The new passwords must match.'; return; }
    const value = {current:form.elements.current.value,password:form.elements.newPassword.value}; lockForm(form,true);
    try { await request('/ui/password','POST',value); clearPrivate(); display(); notice('Password changed. Sign in again.'); }
    catch (error) { $('password-error').textContent = error.message; }
    finally { form.reset(); lockForm(form,false); }
  });
  function renderToken() {
    const exists = !!state.token; $('token-display').hidden = !exists; $('token-value').value = state.token;
    $('token-title').textContent = exists ? 'API token active' : 'No API token yet';
    $('token-description').textContent = exists ? 'Use this token in Home Assistant or your scripts.' : 'Generate one when you’re ready to connect.';
    $('token-status').textContent = exists ? 'Active' : 'Not generated'; $('token-status').className = 'badge ' + (exists ? 'green' : 'neutral');
    $('token-action-label').textContent = exists ? 'Rotate token' : 'Generate token'; $('revoke-token').hidden = !exists;
    $('copy-status').textContent = '';
  }
  async function loadToken(reconcile = false) {
    if (tokenBusy && !reconcile) return;
    const version = tokenVersion, value = await request('/ui/token');
    if (state.authenticated && version === tokenVersion) { state.token = value.token; renderToken(); }
  }
  async function changeToken(method) {
    if (tokenBusy) return; tokenBusy = true; ++tokenVersion; $('generate-token').disabled = $('confirm-revoke').disabled = true;
    try { const value = await request('/ui/token',method,method === 'POST' ? {} : undefined); if (state.authenticated) { state.token = value.token; renderToken(); } $('revoke-dialog').close(); }
    catch (error) { notice(error.message,true); await loadToken(true).catch(() => {}); }
    finally { tokenBusy = false; $('generate-token').disabled = $('confirm-revoke').disabled = false; }
  }
  $('generate-token').addEventListener('click', () => changeToken('POST'));
  $('revoke-token').addEventListener('click', () => $('revoke-dialog').showModal());
  $('confirm-revoke').addEventListener('click', () => changeToken('DELETE'));
  $('copy-token').addEventListener('click', async () => {
    const token = state.token;
    try { await navigator.clipboard.writeText(token); if (state.authenticated && state.token === token) $('copy-status').textContent = 'Token copied.'; }
    catch { if (state.authenticated && state.token === token) { $('token-value').focus(); $('token-value').select(); $('copy-status').textContent = 'Copy the selected token manually.'; } }
  });
  function renderNetwork() {
    const status = flow.status;
    const busy = flow.busy() || !state.nonce;
    for (const [formId,selectId,scanId,statusId] of [['wifi-form','wifi-networks','scan-wifi','scan-status'],['setup-form','setup-networks','setup-scan','setup-scan-status']]) {
      const form = $(formId), setup = formId === 'setup-form';
      for (const field of form.elements) {
        const passwordField = ['webPassword','confirmation'].includes(field.name);
        field.disabled = setup ? setupSubmitting || (passwordField ? state.configured : (!state.portal || busy)) : busy;
      }
      if (setup) $('setup-connect').disabled = setupSubmitting || !state.portal || !state.nonce || busy;
      $(scanId).disabled = busy || setupSubmitting;
      const selector = $(selectId), selected = form.elements.ssid.value;
      selector.replaceChildren(new Option(flow.networks.length ? 'Choose a network' : 'Scan to find networks',''), ...flow.networks.map(n => new Option(n.ssid + ' (' + n.rssi + ' dBm' + (n.secured ? '' : ', open') + ')',n.ssid)));
      selector.value = flow.networks.some(n => n.ssid === selected) ? selected : '';
      selector.disabled = busy || setupSubmitting || !flow.networks.length;
      $(statusId).textContent = flow.error || (flow.starting || flow.scanning ? 'Scanning for nearby networks…' : flow.pending ? 'Find a network, or enter its name.' : flow.networks.length ? 'Choose a network, or enter its name.' : 'No networks found. Enter a name manually or scan again.');
    }
    if (!status) return;
    $('current-wifi').textContent = status.ssid || 'Not connected'; $('wifi-connection').textContent = status.connected ? 'Connected' : 'Disconnected';
    if (state.portal) {
      $('setup-progress').hidden = !['connecting','resetting'].includes(status.state);
      if (status.error) $('setup-error').textContent = status.error;
      if (status.state === 'saved' || status.state === 'configured') {
        setupSaved = true; $('setup-form').hidden = true; $('setup-success').hidden = false; $('setup-progress').hidden = true;
        $('setup-connected-network').textContent = status.ssid; $('setup-address').textContent = 'http://' + status.hostname + '.local/';
      }
    } else if (status.error) notice(status.error,true);
  }
  for (const [formId,selectId,scanId] of [['wifi-form','wifi-networks','scan-wifi'],['setup-form','setup-networks','setup-scan']]) {
    const form = $(formId), select = $(selectId);
    select.addEventListener('change', () => { if (select.value) form.elements.ssid.value = select.value; });
    form.elements.ssid.addEventListener('input', () => { select.value = flow.networks.some(n => n.ssid === form.elements.ssid.value) ? form.elements.ssid.value : ''; });
    $(scanId).addEventListener('click', () => flow.scan().catch(e => notice(e.message,true)));
  }
  $('wifi-form').addEventListener('submit', async event => {
    event.preventDefault(); const form = event.currentTarget;
    const value = {ssid:form.elements.ssid.value,password:form.elements.password.value};
    try { await flow.connect(value); notice('Connection attempt accepted. Keep this page open.'); }
    catch (error) { notice(error.message,true); }
    finally { form.elements.password.value = ''; await flow.poll().catch(() => {}); }
  });
  $('setup-form').addEventListener('submit', async event => {
    event.preventDefault(); if (setupSubmitting || !state.portal) return;
    const form = event.currentTarget, fields = form.elements;
    if (!state.configured && fields.webPassword.value !== fields.confirmation.value) { $('setup-error').textContent = 'The web passwords must match.'; return; }
    const password = fields.webPassword.value, wifi = {ssid:fields.ssid.value,password:fields.wifiPassword.value};
    setupSubmitting = true; renderNetwork(); $('setup-error').textContent = '';
    try {
      if (!state.configured) {
        await request('/ui/enroll','POST',{password}); state.configured = state.authenticated = true;
        $('setup-password-panel').hidden = true;
      }
      await flow.connect(wifi);
    } catch (error) { $('setup-error').textContent = error.message; }
    finally {
      fields.webPassword.value = fields.confirmation.value = fields.wifiPassword.value = '';
      setupSubmitting = false; renderNetwork(); if (state.portal) await flow.poll().catch(() => {});
    }
  });
  $('setup-finish').addEventListener('click', () => location.reload());
  setInterval(async () => {
    pairingStatus();
    if (stopped || booting || passwordWork || (!state.portal && !state.authenticated)) return;
    try { await flow.poll(); }
    catch (error) { if (!setupSaved) notice(error.message,true); }
  },2000);
  window.addEventListener('pagehide', () => { stopped = true; state.token = ''; $('token-value').value = ''; });
  window.addEventListener('pageshow', event => { if (event.persisted) { clearPrivate(); boot(); } });
  boot();
}
)JS";
const char kFavicon[] PROGMEM = R"SVG(<svg xmlns="http://www.w3.org/2000/svg" viewBox="0 0 64 64">
  <rect width="64" height="64" rx="15" fill="#182c2b"/>
  <g fill="#efb372" transform="skewX(-12)">
    <rect x="21" y="20" width="7" height="26" rx="3.5"/>
    <rect x="33" y="13" width="7" height="38" rx="3.5"/>
    <rect x="45" y="20" width="7" height="26" rx="3.5"/>
  </g>
</svg>
)SVG";
}
